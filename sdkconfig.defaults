## sdkconfig.defaults
```kconfig
# ESP32-S3 Word Clock Configuration Defaults

# Target Configuration - ESP32-S3
CONFIG_IDF_TARGET="esp32s3"
CONFIG_IDF_TARGET_ESP32S3=y

# CPU Frequency Configuration - Set to 240MHz
CONFIG_ESP_DEFAULT_CPU_FREQ_MHZ_240=y
CONFIG_ESP_DEFAULT_CPU_FREQ_MHZ=240

# Power Management - Disable to maintain 240MHz
# CONFIG_PM_ENABLE is not set

# Flash configuration - 16MB flash size (ESP32-S3-N16R8)
CONFIG_ESPTOOLPY_FLASHSIZE_16MB=y
CONFIG_ESPTOOLPY_FLASHSIZE="16MB"
CONFIG_ESPTOOLPY_FLASHFREQ_80M=y
CONFIG_ESPTOOLPY_FLASHFREQ="80m"
CONFIG_ESPTOOLPY_FLASHMODE_QIO=y

# PSRAM Configuration - 8MB Octal PSRAM (ESP32-S3-N16R8)
CONFIG_SPIRAM=y
CONFIG_SPIRAM_MODE_OCT=y
CONFIG_SPIRAM_SPEED_80M=y
CONFIG_SPIRAM_USE_MALLOC=y
CONFIG_SPIRAM_MALLOC_ALWAYSINTERNAL=16384

# Main XTAL Frequency
CONFIG_XTAL_FREQ_40=y
CONFIG_XTAL_FREQ=40

# FreeRTOS Tick Rate - 1000Hz for smooth animations
CONFIG_FREERTOS_HZ=1000

# Enable CPU frequency reporting
CONFIG_ESP_CONSOLE_UART_DEFAULT=y
CONFIG_ESP_CONSOLE_UART_BAUDRATE=115200

# Optimization level - Optimize for performance (production)
CONFIG_COMPILER_OPTIMIZATION_PERF=y

# Custom partition table for large application with OTA support
CONFIG_PARTITION_TABLE_CUSTOM=y
CONFIG_PARTITION_TABLE_CUSTOM_FILENAME="partitions_ota.csv"

# Enable logging levels for debugging
CONFIG_LOG_DEFAULT_LEVEL_INFO=y
CONFIG_LOG_DEFAULT_LEVEL=3

# Stack size configurations to prevent overflow during Tier 1 MQTT processing
# Critical: sys_evt task stack size - this task handles WiFi and system events
CONFIG_ESP_SYSTEM_EVENT_TASK_STACK_SIZE=8192
# Main task stack size for complex initialization
CONFIG_ESP_MAIN_TASK_STACK_SIZE=8192
# Timer task stack size for MQTT timers and callbacks
CONFIG_FREERTOS_TIMER_TASK_STACK_DEPTH=8192
# MQTT client task stack size
CONFIG_MQTT_TASK_STACK_SIZE=12288
# TCP/IP task stack size for network operations
CONFIG_LWIP_TCPIP_TASK_STACK_SIZE=8192

# FAT Filesystem Long Filename Support (Phase 2.4)
# Enable LFN with UTF-8 encoding for user-friendly chime filenames
CONFIG_FATFS_LFN_HEAP=y
CONFIG_FATFS_MAX_LFN=255
CONFIG_FATFS_API_ENCODING_UTF_8=y
# Prefer PSRAM for FatFS buffers (optimal for ESP32-S3 with 8MB PSRAM)
CONFIG_FATFS_ALLOC_PREFER_EXTRAM=y
```
